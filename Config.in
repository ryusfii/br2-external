## Config.in
```kconfig
source "$BR2_EXTERNAL_HARDERSOFT_PATH/package/libretro/Config.in"
##source "$BR2_EXTERNAL_BLA_PATH/package/package2/Config.in"
```

## configs/macmini2_defconfig
```kconfig
BR2_x86_64=y
BR2_x86_core2=y
BR2_OPTIMIZE_2=y
BR2_PIC_PIE=y
BR2_RELRO_PARTIAL=y
BR2_TOOLCHAIN_BUILDROOT_WCHAR=y
BR2_PTHREAD_DEBUG=y
BR2_BINUTILS_VERSION_2_32_X=y
BR2_GCC_VERSION_9_X=y
BR2_TOOLCHAIN_BUILDROOT_CXX=y
BR2_TARGET_GENERIC_HOSTNAME="macmini2"
BR2_TARGET_GENERIC_PASSWD_SHA512=y
BR2_ROOTFS_DEVICE_CREATION_DYNAMIC_MDEV=y
BR2_ROOTFS_MERGED_USR=y
# BR2_TARGET_GENERIC_REMOUNT_ROOTFS_RW is not set
BR2_ROOTFS_OVERLAY="$(BR2_EXTERNAL_HARDERSOFT_PATH)/board/hardersoft/macmini2/rootfs-overlay"
BR2_LINUX_KERNEL=y
BR2_LINUX_KERNEL_USE_CUSTOM_CONFIG=y
BR2_LINUX_KERNEL_CUSTOM_CONFIG_FILE="$(BR2_EXTERNAL_HARDERSOFT_PATH)/board/hardersoft/macmini2/linux.config"
BR2_PACKAGE_ALSA_UTILS=y
BR2_PACKAGE_STRACE=y
BR2_PACKAGE_MESA3D=y
BR2_PACKAGE_MESA3D_DRI_DRIVER_SWRAST=y
BR2_PACKAGE_MESA3D_DRI_DRIVER_I915=y
BR2_PACKAGE_MESA3D_DRI_DRIVER_I965=y
BR2_PACKAGE_MESA3D_OPENGL_EGL=y
# BR2_PACKAGE_ALSA_LIB_OLD_SYMBOLS is not set
BR2_PACKAGE_LIBSHA1=y
BR2_PACKAGE_FONTCONFIG=y
BR2_PACKAGE_PIXMAN=y
BR2_PACKAGE_LIBXKBCOMMON=y
BR2_PACKAGE_MTDEV=y
BR2_PACKAGE_LIBEVDEV=y
BR2_PACKAGE_XUTIL_UTIL_MACROS=y
BR2_PACKAGE_SPICE_PROTOCOL=y
BR2_TARGET_ROOTFS_CPIO=y
BR2_TARGET_ROOTFS_CPIO_BZIP2=y
# BR2_TARGET_ROOTFS_TAR is not set
```

## package/libretro-core-beetle-psx/Config.in
```kconfig
config BR2_PACKAGE_LIBRETRO_BEETLE_PSX
	bool "Enable beetle psx core"
	depends on BR2_PACKAGE_LIBRETRO
	help
	  Enable beetle psx core.
```

## package/libretro-core-bsnes/Config.in
```kconfig
config BR2_PACKAGE_LIBRETRO_BSNES
	bool "Enable bsnes core"
	depends on BR2_PACKAGE_LIBRETRO
	help
	  Enable BSNES core.
```

## package/libretro-retroarch-assets/Config.in
```kconfig
config BR2_PACKAGE_LIBRETRO_RETROARCH_ASSETS
	bool
	depends on BR2_PACKAGE_LIBRETRO_RETROARCH
```

## package/libretro-retroarch/Config.in
```kconfig
config BR2_PACKAGE_LIBRETRO_RETROARCH
	bool "retroarch"
	depends on BR2_PACKAGE_LIBRETRO
	select BR2_PACKAGE_LIBRETRO_CORE_INFO
	select BR2_PACKAGE_RETROARCH_ASSETS
	#depends on (BR2_PACKAGE_HAS_LIBGLES || (BR2_PACKAGE_HAS_LIBGL && BR2_PACKAGE_LIBGLEW && BR2_PACKAGE_XORG7))
	#select BR2_PACKAGE_ALSA_LIB
	#select BR2_PACKAGE_LIBGLEW
	#select BR2_PACKAGE_LIBXKBCOMMON
	help
	  Cross-platform, sophisticated frontend for the libretro API

if BR2_PACKAGE_LIBRETRO_RETROARCH

menu "retroarch menus"
config BR2_PACKAGE_LIBRETRO_RETROARCH_XMB
	bool "Enable XMB menu"
	help
	  Enable XMB menu.

config BR2_PACKAGE_LIBRETRO_RETROARCH_RGUI
	bool "Enable RGUI menu"
	help
	  Enable RGUI menu.

config BR2_PACKAGE_LIBRETRO_RETROARCH_MATERIALUI
	bool "Enable MATERIALUI menu"
	help
	  Enable MATERIALUI menu.

config BR2_PACKAGE_LIBRETRO_RETROARCH_OZONE
	bool "Enable OZONE menu"
	help
	  Enable OZONE menu.
endmenu

#choice
#	prompt "Retroarch GL Backend"
#	default BR2_PACKAGE_RETROARCH_GLES
#	help
#	  Select the GL Backend.
#
#	config BR2_PACKAGE_RETROARCH_GLES
#		depends on BR2_PACKAGE_HAS_LIBGLES
#		bool "gles"
#		help
#		  gles
#	config BR2_PACKAGE_RETROARCH_GL
#		depends on BR2_PACKAGE_HAS_LIBGL
#		depends on BR2_PACKAGE_XORG7
#		bool "gl"
#		help
#		  gl
#endchoice

#config BR2_PACKAGE_RETROARCH_MENUS
#	string "Enable menus (rgui materialui ozone xmb)"
#	default rgui
#	help
#	  Space seperated list of menus.

#choice
#	prompt "Retroarch Menu"
#	default BR2_PACKAGE_APACHE_MPM_WORKER
#	help
#	  Select the menu.
#
#config BR2_PACKAGE_RETROARCH_XMB
#	bool "xmb"
#	help
#	  xmb
#
#config BR2_PACKAGE_APACHE_MPM_PREFORK
#	bool "prefork"
#	help
#	  Implements a non-threaded, pre-forking web server
#
#config BR2_PACKAGE_APACHE_MPM_WORKER
#	bool "worker"
#	help
#	  Implements a hybrid multi-threaded multi-process web server
#
#endchoice

endif
```

## package/libretro/Config.in
```kconfig
config BR2_PACKAGE_LIBRETRO
	bool "libretro"
	#depends on ((BR2_PACKAGE_HAS_LIBGLES && BR2_PACKAGE_HAS_LIBEGL) || \

	depends on ((BR2_PACKAGE_HAS_LIBEGL) || (BR2_PACKAGE_HAS_LIBGLES) || \
		(BR2_PACKAGE_HAS_LIBGL && BR2_PACKAGE_LIBGLEW && BR2_PACKAGE_XORG7))
	select BR2_PACKAGE_LIBRETRO_CORE_INFO
	select BR2_PACKAGE_RETROARCH_ASSETS
	#select BR2_PACKAGE_LIBGLEW
	#select BR2_PACKAGE_LIBXKBCOMMON
	help
	  libretro
comment "libretro needs libgles or libgl"
	depends on !BR2_PACKAGE_HAS_LIBGLES || !BR2_PACKAGE_HAS_LIBEGL

if BR2_PACKAGE_LIBRETRO

source "$BR2_EXTERNAL_HARDERSOFT_PATH/package/libretro-retroarch/Config.in"
source "$BR2_EXTERNAL_HARDERSOFT_PATH/package/libretro-retroarch-assets/Config.in"

#choice
#	prompt "libretro GL backend"
#	default BR2_PACKAGE_LIBRETRO_GLES
#	help
#	  Select the GL Backend.
#
menu "libretro GL backends"
	config BR2_PACKAGE_LIBRETRO_GBM
		bool "gbm"
		help
		  gbm

	config BR2_PACKAGE_LIBRETRO_GLES
		depends on BR2_PACKAGE_HAS_LIBGLES
		#depends on BR2_PACKAGE_HAS_LIBEGL
		bool "gles"
		help
		  gles
	comment "gles needs libgles, libegl"
		depends on !BR2_PACKAGE_HAS_LIBGLES || !BR2_PACKAGE_HAS_LIBEGL

	config BR2_PACKAGE_LIBRETRO_GL
		depends on BR2_PACKAGE_HAS_LIBGL
		depends on BR2_PACKAGE_XORG7
		bool "gl"
		help
		  gl
	comment "gl needs libgl, xorg"
		depends on !BR2_PACKAGE_HAS_LIBGL || !BR2_PACKAGE_XORG7
endmenu
#endchoice

menu "libretro audio backends"
	config BR2_PACKAGE_LIBRETRO_ALSA
		#depends on BR2_PACKAGE_ALSA_LIB
		select BR2_PACKAGE_ALSA_LIB
		bool "alsa"
		help
		  alsa
endmenu

menu "libretro cores"
	source "$BR2_EXTERNAL_HARDERSOFT_PATH/package/libretro-core-bsnes/Config.in"
	source "$BR2_EXTERNAL_HARDERSOFT_PATH/package/libretro-core-beetle-psx/Config.in"
endmenu

endif
```
